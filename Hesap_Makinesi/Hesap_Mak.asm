#INCLUDE <P16F877A.INC>
ORG 0X00
TEMP EQU 0X21	;ISLEM TIPI & SAYI SIRASI KONTROL DEGISKENI
SAYI1 EQU 0X22	
SAYI2 EQU 0X23	
SONUC EQU 0X24	
BIRLER EQU 0X26
ONLAR EQU 0X27 
SAYAC1 EQU 0X28	
SAYAC2 EQU 0X29
BANKSEL TRISD
    MOVLW B'11110000'
    MOVWF TRISD
    CLRF TRISB
    CLRF TRISC
    BANKSEL PORTB
    CLRF PORTB
    CLRF PORTC
    CLRF PORTD
    CLRF TEMP
LOOP
	CLRF PORTD
	BSF PORTD,0
	BTFSC PORTD,4
	CALL YEDI
	BTFSC PORTD,5
	CALL SEKIZ
	BTFSC PORTD,6
	CALL DOKUZ
	BTFSC PORTD,7
	BSF TEMP,1 ;BOLME
	
	CLRF PORTD
	BSF 		PORTD,1
	BTFSC 		PORTD,4
	CALL 	DORT
	BTFSC		 PORTD,5
	CALL 	BES
	BTFSC		 PORTD,6
	CALL 	ALTI
	BTFSC 		PORTD,7
	BSF		 TEMP,0   ;CARPMA
	CLRF		 PORTD
	BSF		 PORTD,2
	BTFSC		 PORTD,4
	CALL 	BIR
	BTFSC		 PORTD,5
	CALL	 IKI
	BTFSC 		PORTD,6
	CALL	 UC
	BTFSC		 PORTD,7
	BSF 		TEMP,3  	;CIKARTMA
	CLRF 		PORTD
	BSF		 PORTD,3
	BTFSC 		PORTD,4
	CALL 	ON
	BTFSC		 PORTD,5
	CALL 		SIFIR
	BTFSC 		PORTD,6
	CALL		 ISLEM  ; =
	BTFSC 		PORTD,7
	BSF		 TEMP,2  ; TOPLAMA
	GOTO LOOP
DOKUZ
	MOVLW		 0X09
	BTFSC		 TEMP,4
	MOVWF		 SAYI2
	BTFSS		 TEMP,4
	CALL 		SAYI1YAZ
	RETURN
SEKIZ 
	MOVLW		 0X08
	BTFSC		 TEMP,4
	MOVWF 	SAYI2
	BTFSS		 TEMP,4
	CALL 		SAYI1YAZ
	RETURN
YEDI 
	MOVLW 	0X07
	BTFSC		 TEMP,4
	MOVWF		 SAYI2
	BTFSS 		TEMP,4
	CALL		 SAYI1YAZ
	RETURN
ALTI
	MOVLW 	0X06
	BTFSC 		TEMP,4
	MOVWF		 SAYI2
	BTFSS		 TEMP,4
	CALL		 SAYI1YAZ
	RETURN
BES
	MOVLW 	0X05
	BTFSC 		TEMP,4
	MOVWF 	SAYI2
	BTFSS 		TEMP,4
	CALL 		SAYI1YAZ
	RETURN
DORT 
	MOVLW		 0X04
	BTFSC 		TEMP,4
	MOVWF		 SAYI2
	BTFSS 		TEMP,4
	CALL		 SAYI1YAZ
	RETURN
UC 
	MOVLW		0X03
	BTFSC		TEMP,4
	MOVWF		SAYI2
	BTFSS		TEMP,4
	CALL		SAYI1YAZ
	RETURN
IKI
	MOVLW		0X02
	BTFSC		TEMP,4
	MOVWF		SAYI2
	BTFSS		TEMP,4
	CALL		SAYI1YAZ
	RETURN
BIR
	MOVLW		0X01
	BTFSC		TEMP,4
	MOVWF		SAYI2
	BTFSS		TEMP,4
	CALL		SAYI1YAZ
	RETURN
SIFIR
	MOVLW		0X00
	BTFSC		TEMP,4
	MOVWF		SAYI2
	BTFSS		TEMP,4
	CALL		SAYI1YAZ
	RETURN
ON
	NOP
	RETURN
SAYI1YAZ
	MOVWF	SAYI1
	BSF	TEMP,4
	RETURN
ISLEM 
	BTFSC	TEMP,0
	CALL	CARPMA
	BTFSC	TEMP,1
	CALL	BOLME
	BTFSC	TEMP,2
	CALL	TOPLAMA
	BTFSC	TEMP,3
	CALL	CIKARMA
	CALL	GOSTER
DISPLAYE_BAS
	MOVF		BIRLER,W	
	CALL		LOOKUP
	MOVWF		PORTB
	BSF		PORTC,0
	BCF		PORTC,1
	CALL		GECIKME
	CLRF		PORTB	;--------------
	MOVF 		ONLAR,W
	CALL 		LOOKUP
	MOVWF 	PORTB
	BCF 		PORTC,0
	BSF 		PORTC,1
	CALL 		GECIKME
	CLRF 		PORTB
	GOTO 	DISPLAYE_BAS
	RETURN
TOPLAMA
	MOVF		SAYI1,W
	ADDWF		SAYI2,W
	MOVWF		SONUC
	RETURN
CIKARMA
	MOVF		SAYI2,W
	SUBWF		SAYI1,W
	MOVWF		SONUC
	RETURN
CARPMA
	CLRF	SONUC
	TOPLAM
		MOVF		SAYI2,W
		ADDWF		SONUC,F
		DECFSZ		SAYI1,F
		GOTO		TOPLAM
		MOVF		SONUC,W
		MOVWF		SONUC
	RETURN
BOLME
	MOVF	 SAYI2,W	;BOLEN = SAYI2 ** BOLUNEN =SAYI1
	SUBWF	 SAYI1,F
	BTFSS	 STATUS,C
	RETURN
	INCF 	SONUC,F
	GOTO	 BOLME
GECIKME
	MOVLW	 0X50
	MOVWF	 SAYAC1
D1
	MOVLW	 0X80
	MOVWF	 SAYAC2
D2
	DECFSZ 	SAYAC2,F
	GOTO D2
	DECFSZ 	SAYAC1,F
	GOTO D1
	RETURN
GOSTER			;BIRLER ONLAR BAS AYRILDIGI YER
	MOVLW 	0X0A
	SUBWF		 SONUC,F
	MOVF 		SONUC,W
	BTFSS 		STATUS,C
	GOTO		 BIRLERBAS
	INCF 		ONLAR,F
	GOTO 	GOSTER
BIRLERBAS
	MOVLW		 0X0A
	ADDWF		 SONUC,F
	MOVF		 SONUC,W
	MOVWF		 BIRLER
	RETURN
LOOKUP
ADDWF PCL,F
RETLW B'00111111' ; -0 
RETLW B'00000110' ; -1 
RETLW B'01011011' ; -2 
RETLW B'01001111' ; -3 
RETLW B'01100110' ; -4 
RETLW B'01101101' ; -5
RETLW B'01111101' ; -6 
RETLW B'00000111' ; -7 
RETLW B'01111111' ; -8 
RETLW B'01101111' ; -9 
END
