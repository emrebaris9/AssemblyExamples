LIST P=16F877A
#INCLUDE <P16F877A.INC>

SAYAC1 EQU 0X20
SAYAC2 EQU 0X21
SAYI EQU 0X22


ORG 0X00
GOTO HAZIRLA

HAZIRLA
	BANKSEL SPBRG
	MOVLW D'25'
	MOVWF SPBRG

	BANKSEL TRISC
	MOVLW B'11000000'
	MOVWF TRISC

	BANKSEL TRISB
	CLRF TRISB
	BANKSEL PORTB
	CLRF PORTB
	
	BANKSEL TRISD
	CLRF TRISD
	BANKSEL PORTD
	CLRF PORTD

	BANKSEL TXSTA
	BCF TXSTA,SYNC 
	BSF TXSTA,BRGH 
	
	BANKSEL RCSTA
	BSF RCSTA,SPEN 
	BSF RCSTA,CREN 

	BANKSEL PR2
	MOVLW D'199'
	MOVWF PR2
	
	BANKSEL T2CON
	MOVLW B'00000100'
	MOVWF T2CON
	BANKSEL CCP1CON
	MOVLW B'00001100'
	MOVWF CCP1CON

	BANKSEL CCPR1L
	MOVLW D'100'
	MOVWF CCPR1L  
	CLRF PORTC

LOOP
	BTFSS PIR1,RCIF
	GOTO LOOP
	
KONTROL

	BANKSEL RCREG

	MOVF RCREG,W
	SUBLW A'R' ; MOTORU SAGA DONDUR
	BTFSC STATUS,Z
	GOTO KOMUT_R

	MOVF RCREG,W
	SUBLW A'L' ; MOTORU SOLA DONDUR
	BTFSC STATUS,Z
	GOTO KOMUT_L
	
	MOVF RCREG,W
	SUBLW A'H' ; MOTOR HIZI ARTTIR
	BTFSC STATUS,Z
	GOTO KOMUT_H

	MOVF RCREG,W
	SUBLW 'Y' ; MOTOR HIZI AZALT
	BTFSC STATUS,Z
	GOTO KOMUT_Y

	GOTO LOOP

KOMUT_R
	BCF PORTB,1
	BSF PORTB,0
	GOTO LOOP

KOMUT_L
	BSF PORTB,1
	BCF PORTB,0
	GOTO LOOP	

KOMUT_H
	MOVLW D'200'
	SUBWF CCPR1L,W
	BTFSC STATUS,Z
	GOTO LOOP
	MOVLW D'10'
	ADDWF CCPR1L,F
	GOTO LOOP

KOMUT_Y
	MOVLW D'0'
	SUBWF CCPR1L,W
	BTFSC STATUS,Z
	GOTO LOOP
	MOVLW D'10'
	SUBWF CCPR1L,F
	GOTO LOOP
END