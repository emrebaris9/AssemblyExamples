#INCLUDE    <P16F877A.INC>
    ORG	0X00
    CALL    HAZIRLIK
	
UST_SATIR   
    MOVLW   0X80
    CALL    KOMUT_ISLE
    CLRF 	HARFCEK
LOOP1
    MOVF    HARFCEK,W
    CALL    LOOKUP
    XORLW   0X00
    BTFSC   STATUS,Z
    GOTO    ALT_SATIR
    CALL    KARAKTER_ISLE
    INCF    HARFCEK
    GOTO    LOOP1

ALT_SATIR
    MOVLW   0XC0
    CALL    KOMUT_ISLE
	
	MOVLW 0XFF
	MOVWF GECIKTIR

	INCF HARFCEK
	
RPMYAZ
	MOVF SAYI,W
	MOVWF TEMP
	CALL HEX_TO_DEC
	CALL ATAMA

ALT_SATIR_YAZDIR
    MOVF    HARFCEK,W
    CALL    LOOKUP
    XORLW   0X00
    BTFSC   STATUS,Z
    GOTO    KONTROL
    CALL    KARAKTER_ISLE
    INCF    HARFCEK
    GOTO    ALT_SATIR_YAZDIR 

KONTROL
	MOVF SAYI,W
	MOVWF CCPR1L
	BTFSC PORTA,0
	CALL ARTTIR
	BTFSC PORTA,1
	CALL AZALT
	GOTO KONTROL
	
ARTTIR
	DECFSZ GECIKTIR,F
	CALL GECIKME
	MOVLW D'200'
	SUBWF SAYI,W
	BTFSC STATUS,Z
	RETURN
	MOVLW D'10'
	ADDWF SAYI,F
	GOTO UST_SATIR 
	
AZALT
	DECFSZ GECIKTIR,F
	CALL GECIKME
	MOVLW D'0'
	SUBWF SAYI,W
	BTFSC STATUS,Z
	RETURN
	MOVLW D'10'
	SUBWF SAYI,F
	GOTO UST_SATIR 

HAZIRLIK
    
    HARFCEK	EQU 0X20
    TEMP	EQU 0X21
	GECIKTIR EQU 0X22
	SAYAC EQU 0X23
	SAYAC1 EQU 0X24
    BIRLER	EQU 0X25
    ONLAR	EQU 0X26
    YUZLER	EQU 0X27
	DEGER	EQU 0X28
	SAYI EQU 0X29
	

	BANKSEL ADCON1
	MOVLW 0X06
	MOVWF ADCON1
	BSF TRISA,0
	BSF TRISA,1

	BANKSEL PR2
	MOVLW D'199'
	MOVWF PR2
	
	BANKSEL T2CON
	MOVLW B'00000100' 
	MOVWF T2CON
	
	BANKSEL CCP1CON
	MOVLW B'00001100' 
	MOVWF CCP1CON

    BANKSEL TRISB ;PORTB ÇIKIS YAPILDI
    CLRF    TRISB
    CLRF	TRISC

    BANKSEL PORTB
    CLRF    PORTB
	CLRF	PORTC
	
	MOVLW 0XFF
	MOVWF GECIKTIR
	
	MOVLW D'100'
	MOVWF SAYI
	
	BANKSEL CCPR1L
	MOVF SAYI,W
	MOVWF CCPR1L
	
    BSF		STATUS,C
    MOVLW   0X02 ; LCD AYARLANDI..
    CALL    KOMUT_ISLE
    MOVLW   0X28
    CALL    KOMUT_ISLE
    MOVLW   0X08
    CALL    KOMUT_ISLE
    MOVLW   0X01 
    CALL    KOMUT_ISLE
    MOVLW   0X06
    CALL    KOMUT_ISLE
    MOVLW   0X0C
    CALL    KOMUT_ISLE
    MOVLW   0X01
    CALL    KOMUT_ISLE
    RETURN
    
KOMUT_ISLE
    MOVWF   DEGER
    SWAPF   DEGER,W
    ANDLW   0X0F
    MOVWF   PORTB
    BCF	    PORTB,4
    CALL    PULSE
    
    MOVF    DEGER,W
    ANDLW   0X0F
    MOVWF   PORTB
    BCF	    PORTB,4
    CALL    PULSE
    RETURN
 
KARAKTER_ISLE
    MOVWF   DEGER
    SWAPF   DEGER,W
    ANDLW   0X0F
    MOVWF   PORTB
    BSF	    PORTB,4
    CALL    PULSE
    
    MOVF    DEGER,W
    ANDLW   0X0F
    MOVWF   PORTB
    BSF	    PORTB,4
    CALL    PULSE
    RETURN
    
PULSE
    BSF	    PORTB,5
	CALL 	GECIKME
    BCF	    PORTB,5
	CALL 	GECIKME
    RETURN

HEX_TO_DEC
    CLRF    YUZLER
    CLRF    ONLAR
    CLRF    BIRLER
    
YUZLER_BUL
    MOVLW   D'100'
    SUBWF   TEMP, W
    BTFSS   STATUS, C
    GOTO    ONLAR_BUL
    INCF    YUZLER, F
    MOVLW   D'100'
    SUBWF   TEMP, F
    GOTO    YUZLER_BUL

ONLAR_BUL
    MOVLW   D'10'
    SUBWF   TEMP, W
    BTFSS   STATUS, C
    GOTO    BIRLER_BUL
    INCF    ONLAR, F
    MOVLW   D'10'
    SUBWF   TEMP, F
    GOTO    ONLAR_BUL
    
BIRLER_BUL
    MOVF    TEMP,W
    MOVWF   BIRLER
    RETURN
    
    
ATAMA
	MOVLW ' '
    CALL    KARAKTER_ISLE
	MOVLW ' '
    CALL    KARAKTER_ISLE
	MOVLW ' '
    CALL    KARAKTER_ISLE
    
    MOVF    YUZLER, W
    ADDLW   D'48'
    CALL    KARAKTER_ISLE
    
    MOVF    ONLAR, W
    ADDLW   D'48'
    CALL    KARAKTER_ISLE
    
    MOVF    BIRLER, W
    ADDLW   D'48'
    CALL    KARAKTER_ISLE    
    RETURN

GECIKME
	MOVLW 0X20
	MOVWF SAYAC
D1
	MOVLW 0X20
	MOVWF SAYAC1
D2
	DECFSZ SAYAC1,F
	GOTO D2
	DECFSZ SAYAC,F
	GOTO D1
	RETURN    
LOOKUP
    ADDWF   PCL,F
    RETLW   ' '
    RETLW   ' '
    RETLW   'M'
    RETLW   'O'
    RETLW   'T'
    RETLW   'O'
    RETLW   'R'
    RETLW   ' '
    RETLW	'D'	
    RETLW   'E'
    RETLW   'V'
    RETLW   'R'
    RETLW   'I'   
	RETLW	0X00
	RETLW   ' '
	RETLW	'D'	
    RETLW   'U'
    RETLW   'T'
    RETLW   'Y'
    RETLW   'C'
	RETLW	0X00
END